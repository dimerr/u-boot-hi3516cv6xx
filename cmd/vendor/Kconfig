## cmd/vendor/Kconfig
```kconfig
menu "Vendor command line interface"

config CMD_IPCBOOT
	bool "command for ipc boot"
	depends on ARCH_BSP
	default y
	help
	   Support for testing ddr3 on TI platforms. This command
	   supports memory verification, memory comapre and ecc
	   verification if supported.

config CMD_GETINFO
	bool "command for print mtd info"
	depends on ARCH_BSP
	default y
	help
	   Debug command for K3 power domains. For this to work, the
	   K3 power domain driver must be enabled for the u-boot; by
	   default it is only enabled for SPL.

config CMD_TIMESTAMP
	bool "timestamp - record timestamp"
	depends on ARCH_BSP
	help
	  Enable the 'timestamp' command which record timestamp in DDR since
	  Chip started running.

endmenu
```

## configs/hi3516cv608_emmc_defconfig
```kconfig
CONFIG_ARM=y
CONFIG_SKIP_LOWLEVEL_INIT=y
CONFIG_ARM_SMCCC=y
CONFIG_SYS_THUMB_BUILD=y
# CONFIG_USE_ARCH_MEMCPY is not set
# CONFIG_USE_ARCH_MEMSET is not set
CONFIG_ARCH_BSP=y
CONFIG_SYS_TEXT_BASE=0x41800000
CONFIG_NR_DRAM_BANKS=1
CONFIG_ENV_SIZE=0x40000
CONFIG_ENV_OFFSET=0x80000
CONFIG_IDENT_STRING="hi3516cv608"
CONFIG_TARGET_HI3516CV608=y
CONFIG_VENDER_UBOOT_NAME="hi3516cv608"
CONFIG_BSP_DISABLE_DOWNLOAD=y
CONFIG_SYS_LOAD_ADDR=0x42080000
CONFIG_FIT=y
CONFIG_BOOTSTAGE_STASH_SIZE=4096
CONFIG_BOOTDELAY=0
CONFIG_DELAY_ENVIRONMENT=y
CONFIG_USE_BOOTARGS=y
CONFIG_BOOTARGS="mem=256M console=ttyAMA0,115200n8"
CONFIG_BOOTARGS_SUBST=y
# CONFIG_DISPLAY_CPUINFO is not set
# CONFIG_DISPLAY_BOARDINFO is not set
CONFIG_HUSH_PARSER=y
CONFIG_SYS_PROMPT="# "
# CONFIG_CMD_ELF is not set
# CONFIG_CMD_FDT is not set
# CONFIG_CMD_IMI is not set
# CONFIG_CMD_XIMG is not set
# CONFIG_CMD_DDR_TRAINING is not set
CONFIG_CMD_USB=y
# CONFIG_CMD_ECHO is not set
# CONFIG_CMD_ITEST is not set
# CONFIG_CMD_SOURCE is not set
# CONFIG_CMD_SETEXPR is not set
# CONFIG_CMD_NET is not set
CONFIG_CMD_CACHE=y
CONFIG_CMD_SMC=y
# CONFIG_CMD_IPCBOOT is not set
CONFIG_ENV_IS_IN_MMC=y
CONFIG_MMC_HS200_SUPPORT=y
CONFIG_MMC_SDHCI=y
CONFIG_MMC_SDHCI_ADMA=y
CONFIG_NETDEVICES=y
CONFIG_SFV300_ETH=y
# CONFIG_POWER is not set
CONFIG_CONS_INDEX=0
CONFIG_PL011_SERIAL=y
CONFIG_USB=y
CONFIG_USB_XHCI_HCD=y
CONFIG_USB_STORAGE=y
CONFIG_USB_GADGET=y
CONFIG_MMC_SDHCI_NEBULA=y
CONFIG_MMC_QUICKBOOT=y
CONFIG_FS_FAT=y
# CONFIG_GZIP is not set
CONFIG_HWDEC_V1=y
CONFIG_OF_LIBFDT=y
```

## configs/hi3516cv610_mini_defconfig
```kconfig
CONFIG_ARM=y
CONFIG_SKIP_LOWLEVEL_INIT=y
CONFIG_MINI_BOOT=y
CONFIG_SYS_THUMB_BUILD=y
# CONFIG_USE_ARCH_MEMCPY is not set
# CONFIG_USE_ARCH_MEMSET is not set
CONFIG_ARCH_BSP=y
CONFIG_SYS_TEXT_BASE=0x41800000
CONFIG_NR_DRAM_BANKS=1
CONFIG_ENV_SIZE=0x10000
CONFIG_ENV_OFFSET=0x80000
CONFIG_ENV_SECT_SIZE=0x10000
CONFIG_IDENT_STRING="hi3516cv610"
CONFIG_TARGET_HI3516CV610=y
CONFIG_VENDER_UBOOT_NAME="hi3516cv610"
CONFIG_BSP_DISABLE_DOWNLOAD=y
CONFIG_SYS_LOAD_ADDR=0x42080000
# CONFIG_LOCALVERSION_AUTO is not set
CONFIG_SYS_MALLOC_F=y
# CONFIG_EXPERT is not set
CONFIG_FIT=y
# CONFIG_LEGACY_IMAGE_FORMAT is not set
CONFIG_BOOTSTAGE_STASH_SIZE=4096
CONFIG_BOOTDELAY=0
CONFIG_USE_BOOTARGS=y
CONFIG_BOOTARGS="mem=256M console=ttyAMA0,115200n8"
CONFIG_BOOTARGS_SUBST=y
# CONFIG_DISPLAY_CPUINFO is not set
# CONFIG_DISPLAY_BOARDINFO is not set
# CONFIG_CMDLINE_EDITING is not set
# CONFIG_AUTO_COMPLETE is not set
# CONFIG_SYS_LONGHELP is not set
CONFIG_SYS_PROMPT="# "
# CONFIG_CMD_BDI is not set
# CONFIG_CMD_CONSOLE is not set
# CONFIG_CMD_BOOTD is not set
# CONFIG_CMD_ELF is not set
# CONFIG_CMD_FDT is not set
# CONFIG_CMD_IMI is not set
# CONFIG_CMD_XIMG is not set
# CONFIG_CMD_EXPORTENV is not set
# CONFIG_CMD_IMPORTENV is not set
# CONFIG_CMD_EDITENV is not set
# CONFIG_CMD_SAVEENV is not set
# CONFIG_CMD_ENV_EXISTS is not set
# CONFIG_CMD_CRC32 is not set
# CONFIG_CMD_MEMORY is not set
# CONFIG_CMD_DDR_TRAINING is not set
# CONFIG_CMD_FLASH is not set
# CONFIG_CMD_LOADB is not set
# CONFIG_CMD_LOADS is not set
# CONFIG_CMD_ECHO is not set
# CONFIG_CMD_ITEST is not set
# CONFIG_CMD_SOURCE is not set
# CONFIG_CMD_SETEXPR is not set
# CONFIG_CMD_SLEEP is not set
# CONFIG_CMD_IPCBOOT is not set
CONFIG_ENV_IS_IN_SPI_FLASH=y
CONFIG_ENV_SPI_BUS=0
CONFIG_ENV_SPI_CS=0
CONFIG_ENV_SPI_MAX_HZ=1000000
CONFIG_ENV_SPI_MODE=3
# CONFIG_NET is not set
# CONFIG_GPIO is not set
# CONFIG_I2C is not set
# CONFIG_MMC is not set
CONFIG_MTD=y
CONFIG_FMC=y
CONFIG_FMC_SPI_NOR=y
# CONFIG_PHY_USB is not set
# CONFIG_USB_GADGET is not set
# CONFIG_POWER is not set
CONFIG_CONS_INDEX=0
CONFIG_PL011_SERIAL=y
# CONFIG_GZIP is not set
CONFIG_HWDEC_V1=y
CONFIG_OF_LIBFDT=y

# CONFIG_DM_WARN is not set
CONFIG_TIME_ADDR_OFFSET=0xF800
CONFIG_CMD_TIMESTAMP=y
CONFIG_CMD_UGZIP=y
CONFIG_DTR_MODE_SUPPORT=y
```

## drivers/vendor/mmc/Kconfig
```kconfig
config MMC_SDHCI_NEBULA
	bool "SDHCI support for the Soct SD/SDIO/eMMC controller"
	depends on MMC_SDHCI
	help
	  This selects the Soct SD/SDIO/eMMC driver.
	  If you have a controller with this interface, say Y here.
	  If unsure, say N.

config MMC_QUICKBOOT
	bool "SDHCI support quick boot"
	depends on MMC_SDHCI_NEBULA
	help
	  This selects quick boot.
	  If you want to support quick boot, say Y here.
	  If unsure, say N.
```
